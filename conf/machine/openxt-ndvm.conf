## conf/machine/openxt-ndvm.conf
```bitbake
# Copyright (C) 2010 Citrix Systems
# Released under the MIT license (see packages/COPYING)
#@TYPE: Machine
#@NAME: openxt-ndvm
#@DESCRIPTION: Machine configuration for OpenXT secured backend VM

require openxt-common.conf

MACHINE_FEATURES = "kernel26 ethernet pci ext2 x86"
```

## conf/machine/openxt-nilfvm.conf
```bitbake
# Copyright (C) 2010 Citrix Systems
# Released under the MIT license (see packages/COPYING)
#@TYPE: Machine
#@NAME: openxt-nilfvm
#@DESCRIPTION: Machine configuration for OpenXT VPN VM

require openxt-common.conf

# Use ndvm packages when there's no nilfvm version
PACKAGE_EXTRA_ARCHS_tune-core2 += " openxt-nvdm "

MACHINE_FEATURES = "kernel26 ethernet pci ext2 x86"

SERIAL_CONSOLE = "38400 xvc0"
```

## conf/machine/openxt-sbuild.conf
```bitbake
# Copyright (C) 2010 Citrix Systems
# Released under the MIT license (see packages/COPYING)
#@TYPE: Machine
#@NAME: openxt-sbuild
#@DESCRIPTION: Machine configuration for openxt Debian Packet Builder

require openxt-common.conf

PREFERRED_PROVIDER_virtual/kernel = "sbuild-linux"

MACHINE_FEATURES = "kernel26 ethernet pci ext2 x86"

SERIAL_CONSOLE = "38400 xvc0"
```

## conf/machine/openxt-stubdomain.conf
```bitbake
# Copyright (C) 2010 Citrix Systems
# Released under the MIT license (see packages/COPYING)
#@TYPE: Machine
#@NAME: openxt-stubdomain
#@DESCRIPTION: Machine configuration for OpenXT stubdomain VM

require openxt-common.conf

MACHINE_FEATURES = "kernel26 screen keyboard ethernet pci acpi ext2 x86"
```

## conf/machine/openxt-uivm.conf
```bitbake
# Copyright (C) 2010 Citrix Systems
# Released under the MIT license (see packages/COPYING)
#@TYPE: Machine
#@NAME: openxt-uivm
#@DESCRIPTION: Machine configuration for OpenXT uivm VM

require openxt-common.conf

PREFERRED_PROVIDER_virtual/xserver = "xserver-xorg"
XSERVER = "xserver-xorg \
           xf86-input-evdev \
           xf86-input-mouse \
           xf86-video-fbdev \
           xf86-input-keyboard"

MACHINE_FEATURES = "kernel26 screen keyboard ethernet pci acpi ext2 x86"

DISTRO_FEATURES_append += "opengl"
```
